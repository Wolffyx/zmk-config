## boards/arm/stm32u575test/Kconfig.board
```kconfig
config BOARD_STM32U575TEST
    bool "My Custom STM32U575 Board"
    depends on SOC_STM32U575XX
```

## boards/arm/stm32u575test/Kconfig.defconfig
```kconfig
# DZ60RGB keyboard configuration

# Copyright (c) 2020 The ZMK Contributors
# SPDX-License-Identifier: MIT

if BOARD_STM32U575TEST

config BOARD
    default "stm32u575test"

config ZMK_KEYBOARD_NAME
    default "STM32U575 Board"

config ZMK_USB
    default y

config ZMK_KSCAN_MATRIX_POLLING
    default y


endif # stm32u575test
```

## boards/arm/stm32u575test/stm32u575test_defconfig
```kconfig
#CONFIG_SOC_SERIES_STM32U5X=y
#CONFIG_SOC_STM32U575XX=y
# 72MHz system clock
#CONFIG_SYS_CLOCK_HW_CYCLES_PER_SEC=72000000

# enable GPIO
#CONFIG_GPIO=y

# clock configuration
#CONFIG_CLOCK_CONTROL=y

# Clock configuration for Cube Clock control driver
#CONFIG_CLOCK_STM32_HSE_CLOCK=4800000
#CONFIG_CLOCK_STM32_SYSCLK_SRC_PLL=y
# use HSE as PLL input
#CONFIG_CLOCK_STM32_PLL_SRC_HSE=y
# produce 72MHz clock at PLL output
#CONFIG_CLOCK_STM32_PLL_PREDIV=1
#CONFIG_CLOCK_STM32_PLL_MULTIPLIER=9
#CONFIG_CLOCK_STM32_AHB_PRESCALER=1
#CONFIG_CLOCK_STM32_APB1_PRESCALER=2
#CONFIG_CLOCK_STM32_APB2_PRESCALER=1

#CONFIG_ZMK_USB=y

############################

# SPDX-License-Identifier: MIT

CONFIG_BOARD_LE_CHIFFRE_STM32=y
CONFIG_SOC_SERIES_STM32U5X=y
CONFIG_SOC_STM32U575XX=y
# 48MHz system clock
CONFIG_SYS_CLOCK_HW_CYCLES_PER_SEC=48000000

# enable PINMUX
CONFIG_PINCTRL=y

# enable GPIO
CONFIG_GPIO=y

# Enable i2c
CONFIG_I2C=y

# ZMK Settings
CONFIG_ZMK_USB=y
# CONFIG_ZMK_KSCAN_MATRIX_POLLING=y
CONFIG_USB_SELF_POWERED=n


# clock configuration
CONFIG_CLOCK_CONTROL=y

# ZMK Studio Settings
CONFIG_ZMK_BEHAVIOR_LOCAL_ID_TYPE_CRC16=y
CONFIG_ZMK_STUDIO_RPC_THREAD_STACK_SIZE=3800
CONFIG_ZMK_STUDIO_RPC_TX_BUF_SIZE=32
CONFIG_ZMK_KEYMAP_LAYER_NAME_MAX_LEN=10
CONFIG_FLASH=y
CONFIG_FLASH_MAP=y
CONFIG_NVS=y

# Zephyr Memory Reduction Settings
CONFIG_ISR_STACK_SIZE=756
CONFIG_MAIN_STACK_SIZE=756
CONFIG_USB_CDC_ACM_RINGBUF_SIZE=256
CONFIG_USB_WORKQUEUE_STACK_SIZE=800

# ZMK Specific Memory Reduction
CONFIG_ZMK_BEHAVIOR_HOLD_TAP_MAX_HELD=3
CONFIG_ZMK_BEHAVIOR_HOLD_TAP_MAX_CAPTURED_EVENTS=15
CONFIG_ZMK_BEHAVIOR_STICKY_KEY_MAX_HELD=3
CONFIG_ZMK_BEHAVIORS_QUEUE_SIZE=16
CONFIG_ZMK_COMBO_MAX_PRESSED_COMBOS=1
CONFIG_ZMK_COMBO_MAX_COMBOS_PER_KEY=3
CONFIG_ZMK_COMBO_MAX_KEYS_PER_COMBO=2
```

## config/boards/arm/stm32u575test/Kconfig.board
```kconfig
config BOARD_STM32U575TEST
    bool "Custom STM32U575"
    depends on SOC_STM32U575XX
```
